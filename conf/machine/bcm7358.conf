## conf/machine/bcm7358.conf
```bitbake
#@TYPE: Machine
#@NAME: XCORE 7358
#@DESCRIPTION: Machine configuration for the XCORE 7358

IMAGEDIR = "bcm7358"

MACHINE_ESSENTIAL_EXTRA_RDEPENDS = "\
    xcore-dvb-modules-bcm7358 \
    "

IMAGE_CMD_ubi_append = "\
    mkdir -p ${DEPLOY_DIR_IMAGE}/${IMAGEDIR}; \
    mv ${IMGDEPLOYDIR}/${IMAGE_NAME}.rootfs.ubi ${DEPLOY_DIR_IMAGE}/${IMAGEDIR}/${ROOTFS_FILE}; \
    cp ${DEPLOY_DIR_IMAGE}/${KERNEL_IMAGETYPE}-${MACHINE}.bin ${DEPLOY_DIR_IMAGE}/${IMAGEDIR}/${KERNEL_FILE}; \
    FILESIZE=$(stat -c%s "${DEPLOY_DIR_IMAGE}/${IMAGEDIR}/${ROOTFS_FILE}"); \
    echo ${DISTRO_NAME}-${IMAGE_VERSION}-${MACHINE}-${DATE}_usb > ${DEPLOY_DIR_IMAGE}/${IMAGEDIR}/imageversion; \
    echo "#" > ${DEPLOY_DIR_IMAGE}/sysinit.txt; \
    echo "# DO NOT EDIT THIS FILE" >> ${DEPLOY_DIR_IMAGE}/sysinit.txt; \
    echo "#" >> ${DEPLOY_DIR_IMAGE}/sysinit.txt; \
    echo "flash -noheader -forceerase usbdisk0:${IMAGEDIR}/${KERNEL_FILE} nandflash0.kernel" >> ${DEPLOY_DIR_IMAGE}/sysinit.txt; \
    echo "&& flash -noheader -forceerase -size=${FILESIZE} usbdisk0:${IMAGEDIR}/${ROOTFS_FILE} nandflash0.rootfs" >> ${DEPLOY_DIR_IMAGE}/sysinit.txt; \
    echo "&& setenv -p STARTUP \"boot -z -elf nandflash0.kernel: 'ubi.mtd=rootfs root=ubi0:rootfs rootfstype=ubifs console=ttyS0,115200'\"" >> ${DEPLOY_DIR_IMAGE}/sysinit.txt; \
    cd ${DEPLOY_DIR_IMAGE}; \
    zip ${IMAGE_NAME}_usb.zip ${IMAGEDIR}/*; \
    zip ${IMAGE_NAME}_usb.zip sysinit.txt; \
    rm -f ${DEPLOY_DIR_IMAGE}/*.ubi; \
    rm -f ${DEPLOY_DIR_IMAGE}/*.ubifs; \
    rm -f ${DEPLOY_DIR_IMAGE}/*.manifest; \
    rm -f ${DEPLOY_DIR_IMAGE}/.ubifs; \
    rm -f ${DEPLOY_DIR_IMAGE}/.manifest; \
    rm -rf ${IMAGEDIR}; \
    "
```

## conf/machine/include/xcore-arm.inc
```bitbake
TARGET_ARCH = "arm"
DEFAULTTUNE = "cortexa15hf-neon-vfpv4"
require conf/machine/include/tune-cortexa15.inc

MTD_BOOTFS = "mmcblk1p1"

SOC_FAMILY = "bcm7439"
require conf/machine/include/soc-family.inc

DVBMEDIASINK_CONFIG = "--with-wma --with-wmv --with-pcm --with-dts --with-eac3 --with-h265 --with-vb6 --with-vb8 --with-vb9 --with-spark"

### 8723BS wireless/bluetooth ###
KERNEL_MODULE_AUTOLOAD += "r8723bs"
KERNEL_MODULE_AUTOLOAD += "hci_uart"

IMAGE_FSTYPES ?= "${@bb.utils.contains('MACHINE_FEATURES', 'emmc', 'xcore-emmc', 'ubi', d)}"

MACHINE_FEATURES += "videoenhancement inibt directfb textlcd dvb-c blindscan-tbs linuxwifi linux4extra ci mountboot"

KERNEL_IMAGETYPE = "zImage"
KERNEL_CONSOLE = "ttyS0,115200n8"

GLIBC_EXTRA_OECONF = "--with-tls --with-__thread"

require conf/machine/include/xcore-oem.inc

MACHINE_ESSENTIAL_EXTRA_RRECOMMENDS += "\
    kernel-module-hci-uart \
    "

MACHINE_EXTRA_RRECOMMENDS += "\
    firmware-rtl8723b \
    "

PREFERRED_VERSION_linux-xcore = "4.11"

IMAGE_CLASSES += "image_types_xcore"
IMAGE_ROOTFS_SIZE ?= "294912"

IMAGE_CMD_xcore-emmc_append = "\
    mkdir -p ${DEPLOY_DIR_IMAGE}/${IMAGEDIR}; \
    mv ${DEPLOY_DIR_IMAGE}/${IMAGE_NAME}.rootfs.emmc ${DEPLOY_DIR_IMAGE}/${IMAGEDIR}/emmc.img; \
    cd ${IMAGE_ROOTFS}; \
    tar -cvf ${DEPLOY_DIR_IMAGE}/rootfs.tar -C ${IMAGE_ROOTFS} .; \
    mv ${DEPLOY_DIR_IMAGE}/rootfs.tar ${DEPLOY_DIR_IMAGE}/${IMAGEDIR}/rootfs.tar; \
    bzip2 ${DEPLOY_DIR_IMAGE}/${IMAGEDIR}/rootfs.tar; \
    cp ${DEPLOY_DIR_IMAGE}/zImage ${DEPLOY_DIR_IMAGE}/${IMAGEDIR}/${KERNEL_FILE}; \
    echo ${IMAGE_VER_STRING} > ${DEPLOY_DIR_IMAGE}/${IMAGEDIR}/imageversion; \
    echo "rename this file to 'force' to force an update without confirmation" > ${DEPLOY_DIR_IMAGE}/${IMAGEDIR}/noforce; \
    cd ${DEPLOY_DIR_IMAGE}; \
    zip ${IMAGE_NAME}_usb.zip ${IMAGEDIR}/*; \
    rm -f ${DEPLOY_DIR_IMAGE}/*.ext4; \
    rm -f ${DEPLOY_DIR_IMAGE}/*.manifest; \
    rm -f ${DEPLOY_DIR_IMAGE}/.ext4; \
    rm -f ${DEPLOY_DIR_IMAGE}/.manifest; \
    rm -Rf ${IMAGEDIR}; \
    "

UBI_VOLNAME = "rootfs"

# new 2 GB Flash Model
MKUBIFS_ARGS = "-m 4096 -e 1040384 -c 2048 -F"
UBINIZE_ARGS = "-m 4096 -p 1024KiB"

IMAGE_CMD_ubi_prepend = "\
    rm -rf ${IMAGE_ROOTFS}/boot/*; \
    rm -rf ${IMAGE_ROOTFS}/tmp/*; \
    "

IMAGE_CMD_ubi_append = "\
    mkdir -p ${DEPLOY_DIR_IMAGE}/${IMAGEDIR}; \
    mv ${IMGDEPLOYDIR}/${IMAGE_NAME}.rootfs.ubi ${DEPLOY_DIR_IMAGE}/${IMAGEDIR}/${ROOTFS_FILE}; \
    cp ${DEPLOY_DIR_IMAGE}/${KERNEL_IMAGETYPE}-${MACHINE}.bin ${DEPLOY_DIR_IMAGE}/${IMAGEDIR}/${KERNEL_FILE}; \
    echo ${IMAGE_VER_STRING} > ${DEPLOY_DIR_IMAGE}/${IMAGEDIR}/imageversion; \
    echo "rename this file to 'force' to force an update without confirmation" > ${DEPLOY_DIR_IMAGE}/${IMAGEDIR}/noforce; \
    cd ${DEPLOY_DIR_IMAGE}; \
    zip ${IMAGE_NAME}_usb.zip ${IMAGEDIR}/*; \
    rm -f ${DEPLOY_DIR_IMAGE}/*.ubi; \
    rm -f ${DEPLOY_DIR_IMAGE}/*.ubifs; \
    rm -f ${DEPLOY_DIR_IMAGE}/*.manifest; \
    rm -f ${DEPLOY_DIR_IMAGE}/.ubifs; \
    rm -f ${DEPLOY_DIR_IMAGE}/.manifest; \
    rm -Rf ${IMAGEDIR}; \
    "
```

## conf/machine/include/xcore-mipsel.inc
```bitbake
TARGET_ARCH = "mipsel"
DEFAULTTUNE = "mips32el"
require conf/machine/include/tune-mips32.inc

KERNEL_IMAGETYPE = "vmlinux.gz"
KERNEL_CONSOLE = "ttyS0,115200n8"

require conf/machine/include/xcore-oem.inc

MTD_KERNEL = "mtd2"
MTD_ROOTFS = "mtd3"

ROOTFS_FILE = "rootfs.bin"

DVBMEDIASINK_CONFIG = "--with-wma --with-wmv --with-pcm --with-dts --with-eac3"

require conf/machine/include/soc-family.inc

MACHINE_FEATURES += "textlcd videoenhancement"

MACHINE_ESSENTIAL_EXTRA_RDEPENDS += "\
    xcore-dvb-modules-${MACHINE} \
    "

IMAGE_FSTYPES ?= "ubi"

IMAGE_CMD_ubi_prepend = "\
    rm -rf ${IMAGE_ROOTFS}/boot/*; \
    rm -rf ${IMAGE_ROOTFS}/tmp/*; \
    "

IMAGEDIR = "${MACHINE}"
```

## conf/machine/include/xcore-oem.inc
```bitbake
# We know about rtc
MACHINE_FEATURES_BACKFILL_CONSIDERED += "rtc"

KERNELVERSION = "4.11"

BOX_BRAND = "xcore"

KERNEL_FILE = "kernel.bin"


MACHINE_ESSENTIAL_EXTRA_RDEPENDS += "\
	xcore-dvb-modules-${MACHINE} \
	kernel-module-hci-uart \
	"

PREFERRED_PROVIDER_virtual/blindscan-dvbs = "xcore-blindscan-utils"
PREFERRED_PROVIDER_virtual/blindscan-dvbc = "xcore-blindscan-utils"

PREFERRED_PROVIDER_virtual/kernel = "linux-xcore"
PREFERRED_VERSION_linux-xcore = "${KERNELVERSION}"

MACHINE_FEATURES += "alsa switchoff hdmicec HDMI"

BOOTLOGO_FILENAME = "splash.bin"

KERNEL_MODULE_AUTOLOAD += "\
	r8723bs \
	hci_uart \
	"

RCNAME = "xcore1"
```

## conf/machine/spycat4k.conf
```bitbake
#
# This is config file for SpyCat 4K
#

require conf/machine/include/xcore-arm.inc

MACHINE_FEATURES += "mmc emmc swap"

KERNEL_MODULE_AUTOLOAD += "wlan"

MTD_KERNEL = "mmcblk1p2"
MTD_ROOTFS = "mmcblk1p3"

ROOTFS_FILE = "rootfs.tar.bz2"

IMAGEDIR = "spycat4k"

MACHINE_ESSENTIAL_EXTRA_RDEPENDS = "\
    xcore-dvb-modules-spycat4k \
    "
```

## conf/machine/spycat4kmini.conf
```bitbake
#
# This is config file for SpyCat 4K mini
#

require conf/machine/include/xcore-arm.inc

MACHINE_FEATURES += "mountboot"

MTD_KERNEL = "mtd0"
MTD_ROOTFS = "mtd2"

ROOTFS_FILE = "rootfs.bin"
```

## conf/machine/spycatminiplus.conf
```bitbake
#@TYPE: Machine
#@NAME: SpyCat Mini Plus
#@DESCRIPTION: Machine configuration for SpyCat Mini Plus

require conf/machine/include/xcore-mipsel.inc

SOC_FAMILY = "bcm7362"

PREFERRED_VERSION_linux-xcore = "4.11"

UBI_VOLNAME = "rootfs"
MKUBIFS_ARGS = "-m 2048 -e 126976 -c 4096 -F"
UBINIZE_ARGS = "-m 2048 -p 128KiB"

IMAGE_CMD_ubi_append = "\
    mkdir -p ${DEPLOY_DIR_IMAGE}/${IMAGEDIR}; \
    cp ${DEPLOY_DIR_IMAGE}/splash.bin ${DEPLOY_DIR_IMAGE}/${IMAGEDIR}/splash.bin; \
    mv ${IMGDEPLOYDIR}/${IMAGE_NAME}.rootfs.ubi ${DEPLOY_DIR_IMAGE}/${IMAGEDIR}/${ROOTFS_FILE}; \
    cp ${DEPLOY_DIR_IMAGE}/${KERNEL_IMAGETYPE}-${MACHINE}.bin ${DEPLOY_DIR_IMAGE}/${IMAGEDIR}/${KERNEL_FILE}; \
    echo ${IMAGE_VER_STRING} > ${DEPLOY_DIR_IMAGE}/${IMAGEDIR}/imageversion; \
    echo "rename this file to 'force' to force an update without confirmation" > ${DEPLOY_DIR_IMAGE}/${IMAGEDIR}/noforce; \
    cd ${DEPLOY_DIR_IMAGE}; \
    zip ${IMAGE_NAME}_usb.zip ${IMAGEDIR}/*; \
    rm -f ${DEPLOY_DIR_IMAGE}/*.ubi; \
    rm -f ${DEPLOY_DIR_IMAGE}/*.ubifs; \
    rm -f ${DEPLOY_DIR_IMAGE}/*.manifest; \
    rm -f ${DEPLOY_DIR_IMAGE}/.ubifs; \
    rm -f ${DEPLOY_DIR_IMAGE}/.manifest; \
    rm -Rf ${IMAGEDIR}; \
    "

MACHINE_FEATURES += "inibt blindscan-dvbc dvb-c blindscan-tbs linuxwifi linux4extra 7segment"

KERNEL_MODULE_AUTOLOAD += "hci_uart" 

MACHINE_ESSENTIAL_EXTRA_RRECOMMENDS += " \
    kernel-module-hci-uart \
    "

DVBMEDIASINK_CONFIG += "--with-h265"
```
